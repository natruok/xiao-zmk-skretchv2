## config/boards/shields/Kconfig.defconfig
```kconfig
# Copyright (c) 2020 The ZMK Contributors
# SPDX-License-Identifier: MIT

if SHIELD_REVXLP

config ZMK_KEYBOARD_NAME
    default "skretchv2"

if ZMK_BACKLIGHT

config LED_GPIO
    default y

endif # ZMK_BACKLIGHT

endif
```

## config/boards/shields/Kconfig.shield
```kconfig
# Copyright (c) 2020 The ZMK Contributors
# SPDX-License-Identifier: MIT

config SHIELD_SKRETCHV2
    def_bool $(shields_list_contains,skretchv2)
    select SPI
```
